/ {
    compatible = "zmk,keyboard";
    description = "Two Key Board";

    // No matriz, cada tecla va a un pin separado
    keymap {
        compatible = "zmk,keymap";

        default_layer {
            bindings = <
                &kp K
                &kp I
            >;
        };
    };
};

&kscan {
    row-gpios = <&gpio0 31>, <&gpio0 29>;  // Cambia estos pines si usás otros
    col-gpios = <>;
};
